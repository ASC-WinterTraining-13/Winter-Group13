/*********************************************************************************************************************
* MM32F327X-G8P Opensourec Library 即（MM32F327X-G8P 开源库）是一个基于官方 SDK 接口的第三方开源库
* Copyright (c) 2022 SEEKFREE 逐飞科技
* 
* 本文件是 MM32F327X-G8P 开源库的一部分
* 
* MM32F327X-G8P 开源库 是免费软件
* 您可以根据自由软件基金会发布的 GPL（GNU General Public License，即 GNU通用公共许可证）的条款
* 即 GPL 的第3版（即 GPL3.0）或（您选择的）任何后来的版本，重新发布和/或修改它
* 
* 本开源库的发布是希望它能发挥作用，但并未对其作任何的保证
* 甚至没有隐含的适销性或适合特定用途的保证
* 更多细节请参见 GPL
* 
* 您应该在收到本开源库的同时收到一份 GPL 的副本
* 如果没有，请参阅<https://www.gnu.org/licenses/>
* 
* 额外注明：
* 本开源库使用 GPL3.0 开源许可证协议 以上许可申明为译文版本
* 许可申明英文版在 libraries/doc 文件夹下的 GPL3_permission_statement.txt 文件中
* 许可证副本在 libraries 文件夹下 即该文件夹下的 LICENSE 文件
* 欢迎各位使用并传播本程序 但修改内容时必须保留逐飞科技的版权声明（即本声明）
* 
* 文件名称          zf_device_HC_04
* 公司名称          成都逐飞科技有限公司
* 版本信息          查看 libraries/doc 文件夹内 version 文件 版本说明
* 开发环境          IAR 8.32.4 or MDK 5.37
* 适用平台          MM32F327X_G8P
* 店铺链接          https://seekfree.taobao.com/
* 
* 修改记录
* 日期              作者                备注
* 2024-05-13        AI Assistant        first version for HC-04
********************************************************************************************************************/
/*********************************************************************************************************************
* 接线定义：
*                   ------------------------------------
*                   模块管脚            单片机管脚
*                   RX                  查看 zf_device_HC_04.h 中 HC_04_RX_PINx 宏定义
*                   TX                  查看 zf_device_HC_04.h 中 HC_04_TX_PINx 宏定义
*                   VCC                 3.3V或5V电源（根据模块版本）
*                   GND                 电源地
*                   EN                  接高电平或悬空（进入AT模式时需接低电平）
*                   STATE               状态指示引脚（可选）
*                   ------------------------------------
********************************************************************************************************************/

#include "zf_common_clock.h"
#include "zf_common_debug.h"
#include "zf_common_fifo.h"
#include "zf_driver_gpio.h"
#include "zf_driver_uart.h"
#include "zf_driver_delay.h"
#include "zf_device_type.h"

#include "zf_device_HC_04.h"

static  fifo_struct     hc_04_fifo;
static  uint8           hc_04_buffer[HC_04_BUFFER_SIZE];        // 数据存放数组
static  uint8           hc_04_data = 0;
static  uint8           hc_04_at_mode = 0;                      // AT模式标志
static  uint32          hc_04_current_baud = HC_04_BAUD_RATE;   // 当前波特率

//-------------------------------------------------------------------------------------------------------------------
// 函数简介     HC-04 蓝牙模块 发送单个字节
// 参数说明     data            8bit 数据
// 返回参数     uint32          发送状态 0-超时 1-成功
// 使用示例     hc_04_send_byte(0x5A);
// 备注信息     无硬件流控，直接发送
//-------------------------------------------------------------------------------------------------------------------
uint32 hc_04_send_byte (const uint8 data)
{
    uint16 time_count = HC_04_SEND_TIMEOUT;
    
    while(time_count)
    {
        // 逐飞库可能没有uart_get_tx_empty_flag函数，改用延时等待
        // 简单延时后直接发送
        uart_write_byte(HC_04_INDEX, data);                // 发送数据
        system_delay_ms(1);  // 简单延时，确保数据发送
        return 1;
        
        time_count--;
        system_delay_ms(1);
    }
    return 0;                                                   // 发送超时
}

//-------------------------------------------------------------------------------------------------------------------
// 函数简介     HC-04 蓝牙模块 发送数据缓冲区
// 参数说明     buff            需要发送的数据地址
// 参数说明     len             发送长度
// 返回参数     uint32          剩余未发送的字节数
// 使用示例     hc_04_send_buffer(buff, 16);
// 备注信息     无硬件流控，分块发送避免阻塞
//-------------------------------------------------------------------------------------------------------------------
uint32 hc_04_send_buffer (const uint8 *buff, uint32 len)
{
    zf_assert(NULL != buff);
    uint32 sent_len = 0;
    uint16 time_count = 0;
    
    while(sent_len < len)
    {
        // 逐飞库可能没有uart_get_tx_empty_flag函数，简单延时发送
        uart_write_byte(HC_04_INDEX, buff[sent_len]);
        sent_len++;
        time_count = 0;
        
        // 每发送10个字节延时1ms，避免发送过快
        if(sent_len % 10 == 0)
        {
            system_delay_ms(1);
        }
        
        // 超时检查
        if(HC_04_SEND_TIMEOUT <= (++time_count))            // 超出了最大等待时间
        {
            break;                                          // 退出发送
        }
    }
    return (len - sent_len);                                    // 返回未发送的字节数
}

//-------------------------------------------------------------------------------------------------------------------
// 函数简介     HC-04 蓝牙模块 发送字符串
// 参数说明     *str            要发送的字符串地址
// 返回参数     uint32          剩余未发送的字节数
// 使用示例     hc_04_send_string("Hello HC-04");
// 备注信息     
//-------------------------------------------------------------------------------------------------------------------
uint32 hc_04_send_string (const char *str)
{
    zf_assert(NULL != str);
    return hc_04_send_buffer((const uint8 *)str, strlen(str));
}

//-------------------------------------------------------------------------------------------------------------------
// 函数简介     HC-04 蓝牙模块 发送摄像头图像
// 参数说明     *image_addr     需要发送的图像地址
// 参数说明     image_size      图像的大小
// 返回参数     void
// 使用示例     hc_04_send_image(&mt9v03x_image[0][0], MT9V03X_IMAGE_SIZE);
// 备注信息     
//-------------------------------------------------------------------------------------------------------------------
void hc_04_send_image (const uint8 *image_addr, uint32 image_size)
{
    zf_assert(NULL != image_addr);
    
    // 发送图像帧头
    extern uint8 camera_send_image_frame_header[4];
    hc_04_send_buffer(camera_send_image_frame_header, 4);
    
    // 发送图像数据
    hc_04_send_buffer(image_addr, image_size);
}

//-------------------------------------------------------------------------------------------------------------------
// 函数简介     HC-04 蓝牙模块 读取数据到缓冲区
// 参数说明     buff            存储的数据地址
// 参数说明     len             期望读取的长度
// 返回参数     uint32          实际读取字节数
// 使用示例     hc_04_read_buffer(buff, 16);
// 备注信息     
//-------------------------------------------------------------------------------------------------------------------
uint32 hc_04_read_buffer (uint8 *buff, uint32 len)
{
    zf_assert(NULL != buff);
    uint32 data_len = len;
    fifo_read_buffer(&hc_04_fifo, buff, &data_len, FIFO_READ_AND_CLEAN);
    return data_len;
}

//-------------------------------------------------------------------------------------------------------------------
// 函数简介     HC-04 蓝牙模块 读取单个字节
// 参数说明     void
// 返回参数     uint8           读取到的字节
// 使用示例     byte = hc_04_read_byte();
// 备注信息     如果缓冲区为空，返回0
//-------------------------------------------------------------------------------------------------------------------
uint8 hc_04_read_byte (void)
{
    uint8 data = 0;
    uint32 len = 1;
    
    // 逐飞库可能没有fifo_get_used_size函数，改用fifo_read_buffer检查
    // 尝试读取一个字节
    fifo_read_buffer(&hc_04_fifo, &data, &len, FIFO_READ_ONLY);
    
    return data;
}

//-------------------------------------------------------------------------------------------------------------------
// 函数简介     HC-04 蓝牙模块 获取接收缓冲区数据长度
// 参数说明     void
// 返回参数     uint32          缓冲区中的数据字节数
// 使用示例     len = hc_04_get_rx_length();
// 备注信息     简化实现，返回FIFO可用数据大小
//-------------------------------------------------------------------------------------------------------------------
uint32 hc_04_get_rx_length (void)
{
    // 简化实现，使用FIFO内部状态判断
    // 注意：逐飞库的fifo实现可能没有直接获取大小的函数
    // 这里使用一个简单的实现，可能需要根据实际库调整
    uint32 available = 0;
    // 假设fifo有一个获取可用数据大小的函数，如果没有，这个函数可能无法准确实现
    // 这里暂时返回0，需要根据实际情况修改
    return available;
}

//-------------------------------------------------------------------------------------------------------------------
// 函数简介     HC-04 蓝牙模块 清空接收缓冲区
// 参数说明     void
// 返回参数     void
// 使用示例     hc_04_clear_rx_buffer();
// 备注信息     
//-------------------------------------------------------------------------------------------------------------------
void hc_04_clear_rx_buffer (void)
{
    fifo_clear(&hc_04_fifo);
}

//-------------------------------------------------------------------------------------------------------------------
// 函数简介     HC-04 蓝牙模块 获取连接状态
// 参数说明     void
// 返回参数     uint8           连接状态
// 使用示例     state = hc_04_get_state();
// 备注信息     如果使用了STATE引脚，通过引脚电平判断；否则通过通信测试判断
//-------------------------------------------------------------------------------------------------------------------
uint8 hc_04_get_state (void)
{
#ifdef HC_04_STATE_PIN
    // 如果定义了STATE引脚，通过引脚电平判断
    // HC-04的STATE引脚：未连接时输出低电平，连接后输出高电平
    return gpio_get_level(HC_04_STATE_PIN) ? HC_04_STATE_CONNECTED : HC_04_STATE_DISCONNECTED;
#else
    // 如果没有定义STATE引脚，默认返回已连接（简化处理）
    return HC_04_STATE_CONNECTED;
#endif
}

//-------------------------------------------------------------------------------------------------------------------
// 函数简介     HC-04 蓝牙模块 检查连接状态
// 参数说明     void
// 返回参数     uint8           连接状态 0-未连接 1-已连接
// 使用示例     connected = hc_04_check_connection();
// 备注信息     通过发送测试命令检查连接
//-------------------------------------------------------------------------------------------------------------------
uint8 hc_04_check_connection (void)
{
    // 简单的连接检查：尝试发送一个字节并检查是否有响应
    // 实际应用中可能需要更复杂的检测机制
    return hc_04_get_state();
}

//-------------------------------------------------------------------------------------------------------------------
// 函数简介     HC-04 蓝牙模块 串口中断回调函数
// 参数说明     void
// 返回参数     void
// 使用示例     
// 备注信息     该函数在 ISR 文件的串口中断程序被调用
//-------------------------------------------------------------------------------------------------------------------
void hc_04_uart_callback (void)
{
    if(uart_query_byte(HC_04_INDEX, &hc_04_data))               // 读取串口数据
    {
        fifo_write_buffer(&hc_04_fifo, &hc_04_data, 1);         // 存入 FIFO
    }
}

//-------------------------------------------------------------------------------------------------------------------
// 函数简介     HC-04 蓝牙模块 进入AT命令模式
// 参数说明     void
// 返回参数     uint8           进入状态 0-失败 1-成功
// 使用示例     hc_04_enter_at_mode();
// 备注信息     HC-04进入AT模式的方法：EN引脚接低电平，或发送"AT"命令
//-------------------------------------------------------------------------------------------------------------------
uint8 hc_04_enter_at_mode (void)
{
    // 方法1：如果模块支持EN引脚控制
    // 方法2：发送AT命令（某些版本支持）
    
    hc_04_at_mode = 1;
    // 这里可以添加具体的AT模式进入代码
    // 例如：设置EN引脚为低电平
    
    return 1;
}

//-------------------------------------------------------------------------------------------------------------------
// 函数简介     HC-04 蓝牙模块 退出AT命令模式
// 参数说明     void
// 返回参数     uint8           退出状态 0-失败 1-成功
// 使用示例     hc_04_exit_at_mode();
// 备注信息     
//-------------------------------------------------------------------------------------------------------------------
uint8 hc_04_exit_at_mode (void)
{
    hc_04_at_mode = 0;
    // 这里可以添加具体的AT模式退出代码
    // 例如：设置EN引脚为高电平
    
    return 1;
}

//-------------------------------------------------------------------------------------------------------------------
// 函数简介     HC-04 蓝牙模块 发送AT命令
// 参数说明     *at_cmd         AT命令字符串
// 参数说明     *response       响应缓冲区
// 参数说明     timeout         超时时间（毫秒）
// 返回参数     uint8           执行状态 0-失败 1-成功
// 使用示例     hc_04_send_at_command("AT", response, 1000);
// 备注信息     
//-------------------------------------------------------------------------------------------------------------------
uint8 hc_04_send_at_command (const char *at_cmd, char *response, uint32 timeout)
{
    zf_assert(NULL != at_cmd);
    zf_assert(NULL != response);
    
    uint32 start_time = 0;  // 简化处理，使用循环计数代替时间戳
    uint32 count = 0;
    uint32 len = 0;
    
    // 清空接收缓冲区
    hc_04_clear_rx_buffer();
    
    // 发送AT命令
    hc_04_send_string(at_cmd);
    hc_04_send_string("\r\n");  // AT命令通常以回车换行结束
    
    // 等待响应
    while(count < (timeout/10))  // 简化：使用循环计数作为超时
    {
        // 尝试读取数据
        len = 0;
        // 这里简化处理，实际应该检查接收缓冲区
        
        if(len > 0)
        {
            // 读取响应
            hc_04_read_buffer((uint8 *)response, len);
            response[len] = '\0';  // 添加字符串结束符
            
            // 检查是否收到OK响应
            // 简化：假设收到任何响应都算成功
            if(len > 0)
            {
                return 1;
            }
        }
        system_delay_ms(10);
        count++;
    }
    
    return 0;  // 超时或未收到响应
}

//-------------------------------------------------------------------------------------------------------------------
// 函数简介     HC-04 蓝牙模块 设置设备名称
// 参数说明     *name           设备名称字符串
// 返回参数     uint8           设置状态 0-失败 1-成功
// 使用示例     hc_04_set_name("MyHC-04");
// 备注信息     
//-------------------------------------------------------------------------------------------------------------------
uint8 hc_04_set_name (const char *name)
{
    char at_cmd[64];
    char response[128];
    
    // 注意：不同的HC-04版本AT命令可能不同
    sprintf(at_cmd, "AT+NAME%s", name);
    return hc_04_send_at_command(at_cmd, response, 1000);
}

//-------------------------------------------------------------------------------------------------------------------
// 函数简介     HC-04 蓝牙模块 设置配对码
// 参数说明     *pin            配对码字符串（通常为4位数字）
// 返回参数     uint8           设置状态 0-失败 1-成功
// 使用示例     hc_04_set_pin("1234");
// 备注信息     
//-------------------------------------------------------------------------------------------------------------------
uint8 hc_04_set_pin (const char *pin)
{
    char at_cmd[64];
    char response[128];
    
    sprintf(at_cmd, "AT+PIN%s", pin);
    return hc_04_send_at_command(at_cmd, response, 1000);
}

//-------------------------------------------------------------------------------------------------------------------
// 函数简介     HC-04 蓝牙模块 设置波特率
// 参数说明     baud_rate       波特率值
// 返回参数     uint8           设置状态 0-失败 1-成功
// 使用示例     hc_04_set_baud_rate(115200);
// 备注信息     设置成功后需要重新初始化串口
//-------------------------------------------------------------------------------------------------------------------
uint8 hc_04_set_baud_rate (uint32 baud_rate)
{
    char at_cmd[64];
    char response[128];
    
    // 修正格式化字符串，使用%u而不是%lu
    sprintf(at_cmd, "AT+UART=%u,0,0", baud_rate);
    
    if(hc_04_send_at_command(at_cmd, response, 1000))
    {
        hc_04_current_baud = baud_rate;
        return 1;
    }
    
    return 0;
}

//-------------------------------------------------------------------------------------------------------------------
// 函数简介     HC-04 蓝牙模块 初始化
// 参数说明     baud_rate       波特率（可选，默认为HC_04_BAUD_RATE）
// 返回参数     uint8           初始化状态 0-成功 1-失败
// 使用示例     hc_04_init(9600); 或 hc_04_init(HC_04_BAUD_RATE);
// 备注信息     
//-------------------------------------------------------------------------------------------------------------------
uint8 hc_04_init (uint32 baud_rate)
{
    uint8 return_state = 0;
    
    if(baud_rate == 0)
    {
        baud_rate = HC_04_BAUD_RATE;
    }
    
    hc_04_current_baud = baud_rate;
    
    // 注册设备类型和回调函数
    // 注意：如果zf_device_type.h中没有BLUETOOTH_HC_04，可以使用其他蓝牙类型
    // 或者修改zf_device_type.h添加BLUETOOTH_HC_04
    set_wireless_type(BLUETOOTH_CH9141, hc_04_uart_callback);  // 暂时使用CH9141类型
    
    // 初始化FIFO缓冲区
    fifo_init(&hc_04_fifo, FIFO_DATA_8BIT, hc_04_buffer, HC_04_BUFFER_SIZE);
    
#ifdef HC_04_STATE_PIN
    // 初始化状态引脚（如果有）
    gpio_init(HC_04_STATE_PIN, GPI, 0, GPI_PULL_UP);
#endif
    
    // 初始化串口
    // 注意：根据逐飞库的uart_init函数参数顺序调整
    // uart_init参数：串口号，波特率，TX引脚，RX引脚
    uart_init(HC_04_INDEX, hc_04_current_baud, HC_04_TX_PIN, HC_04_RX_PIN);
    uart_rx_interrupt(HC_04_INDEX, 1);
    
    return return_state;
}

//-------------------------------------------------------------------------------------------------------------------
// 函数简介     HC-04 蓝牙模块 反初始化
// 参数说明     void
// 返回参数     uint8           反初始化状态 0-成功 1-失败
// 使用示例     hc_04_deinit();
// 备注信息     逐飞库可能没有uart_deinit函数，这里简化处理
//-------------------------------------------------------------------------------------------------------------------
uint8 hc_04_deinit (void)
{
    // 关闭串口中断
    uart_rx_interrupt(HC_04_INDEX, 0);
    
    // 注意：逐飞库可能没有uart_deinit函数
    // 可以调用其他函数关闭串口，或者不做处理
    
    // 清空FIFO缓冲区
    fifo_clear(&hc_04_fifo);
    
    return 0;
}